## app/Kconfig
```kconfig
config ZMK_OS_LAYER
    bool "OS Layer switching based on BLE profile"
    default n
```

## boards/shields/dax3/Kconfig.defconfig
```kconfig
if SHIELD_DAX3_R

config ZMK_KEYBOARD_NAME
  default "dax3_R"

config ZMK_SPLIT_ROLE_CENTRAL
  default y

endif

if SHIELD_DAX3_L

config ZMK_KEYBOARD_NAME
  default "dax3_L"

endif

if SHIELD_DAX3_R || SHIELD_DAX3_L

config ZMK_SPLIT
  default y

endif
```

## boards/shields/dax3/Kconfig.shield
```kconfig
config SHIELD_DAX3_R
  def_bool $(shields_list_contains,dax3_R)

config SHIELD_DAX3_L
  def_bool $(shields_list_contains,dax3_L)
```

## config/west.yml
```yaml
manifest:
  remotes:
    - name: zmkfirmware
      url-base: https://github.com/zmkfirmware
    - name: kumamuk-git
      url-base: https://github.com/kumamuk-git
    - name: caksoylar
      url-base: https://github.com/caksoylar
  projects:
    - name: zmk
      remote: zmkfirmware
      revision: v0.3
      import: app/west.yml
    - name: zmk-pmw3610-driver
      remote: kumamuk-git
      revision: main
    - name: zmk-rgbled-widget
      remote: caksoylar
      revision: a3510c9d  # Last version compatible with ZMK v0.3 (seeeduino_xiao_ble)
  self:
    path: config
```
